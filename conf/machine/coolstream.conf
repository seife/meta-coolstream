## conf/machine/coolstream.conf
```bitbake
#@TYPE: Machine
#@NAME: Coolstream HD1 Set Top Box
#@DESCRIPTION: Machine configuration for the Coolstream HD1 (HD1, Neo, Neo2, Zee) Boxes
#@MAINTAINER: Stefan Seyfried

include conf/machine/include/hd1-default-settings.inc
include conf/machine/include/hd1-default-versions.inc
include conf/machine/include/hd1-default-providers.inc
require conf/machine/include/tune-arm1176ej-s.inc

IMAGE_FSTYPES ?= "tar.bz2 ext3"

SERIAL_CONSOLE = "115200 ttyAMA0"

MACHINE_KERNEL_PR = "r0"

XSERVER = " \
"

KERNEL_IMAGETYPE = "zImage"

MACHINE_FEATURES = "kernel26 apm usbhost keyboard vfat ext2 wifi"

#HD1 has no hardware clock
MACHINE_FEATURES_BACKFILL_CONSIDERED = "rtc"

MACHINE_EXTRA_RRECOMMENDS += " \
	kernel-modules \
"
```

## conf/machine/include/hd1-default-providers.inc
```bitbake
# Coolstream HD1 BSP default providers

PREFERRED_PROVIDER_virtual/kernel = "linux-hd1"
PREFERRED_PROVIDER_virtual/xserver = "none"

PREFERRED_PROVIDER_virtual/stb-hal-libs = "cs-drivers"

PREFERRED_PROVIDER_ffmpeg = "ffmpeg"
PREFERRED_VERSION_ffmpeg = "2.3%"
```

## conf/machine/include/hd1-default-settings.inc
```bitbake
# Coolstream HD1 BSP default settings

IMAGE_CLASSES += "usb_image-hd1"
JFFS2_ERASEBLOCK = "0x20000"
JFFS2_SUM_EXTRA_ARGS = "-p -e 0x20000"
EXTRA_IMAGECMD_jffs2 = "-p -U --cleanmarker=12"
```

## conf/machine/include/hd1-default-versions.inc
```bitbake
# Coolstream HD1 BSP default versions

# "upstream" seems to use 4.6.3, so let's avoid gcc 5.x for now
GCCVERSION ?= "4.9%"

# currently usable kernel version, use the same for headers
LINUXLIBCVERSION ?= "2.6.34%"
```
